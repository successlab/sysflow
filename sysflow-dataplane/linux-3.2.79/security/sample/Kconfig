## sysflow-dataplane/linux-3.2.79/security/sample/Kconfig
```kconfig
config SECURITY_SAMPLE
	bool "Sample"
	default n
	help
	  This selects the Sample.
	  If you are unsure how to answer this question, answer N.
```
